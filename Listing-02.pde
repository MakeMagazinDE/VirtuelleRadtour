<isol>


@li:import processing.net.*; 
import processing.serial.*; 

// Globale Variablen 
Client client; 
Serial myPort;  
int[] average = {255,255,255,255,255,255,255,255,255,255}; 
int pointer; 
int avrg = 255; 
int videoSpeed;   // 0 = stop  50 = half speed   100 = normal  200 = double speed 

// Initialisierung der Telnet-Verbindung und der seriellen Schnittstelle
void setup(){ 
  size(150, 280); 
  noStroke();
// COM-Nummer auf Arduino-Port anpassen! 
  myPort = new Serial(this, "COM7", 9600);      
  client = new Client(this, "127.0.0.1", 1234); 
  pointer = 0; 
  
  // Player in 10% Schritten bis aus Null herunterfahren (Standbild)
  for (int i=0; i<12; i++) {
     client.write("key key-rate-normal"+"\r\n"); 
     client.clear(); 
  } 
  videoSpeed = 0; 
} 

// Diese Funktion wird 30 mal pro Sekunde aufgerufen
void draw() { 
  int h; 
  
  background(0); 
  fill(127); 
  rect(30,10,90,260); 
  
// Byte auf serieller Schnittstelle empfangen 
  if (myPort.available() > 0) { 
     average[pointer] = myPort.readChar();  // Mittelwertbildung über 10 Werte
     pointer++; 
     if (pointer > 9) pointer = 0; 
     avrg = 0; 
     for (int i=0; i<10; i++) {  // Berechnung des Mittelwerts 
        avrg += average[i]; 
     }  
     avrg = avrg / 10; 
  } 

  h = 5000/int(avrg)-20;   // Invertierung um einen Wert proportional zur 
                           //Geschwindigkeit zu erhalten (v ~ 1/t) 
  fill(255,0,0);           // Tacho als Balkenanzeige zeichnen 
  rect(30,260-h,90,h); 

  if (h > videoSpeed+5) {   // Abspielgeschwindigkeit erhöhen
    client.write("key key-rate-faster-fine" +"\r\n"); 
    client.clear(); 
    videoSpeed += 10; 
  } 

  if (h < videoSpeed-5) {  //Abspielgeschwindigkeit vermindern
    client.write("key key-rate-slower-fine" +"\r\n"); 
    client.clear(); 
    videoSpeed -= 10; 
  } 
} 

